## wic/sunxi-mmc-spl.wks
```
part u-boot --source rawcopy --sourceparams="file=u-boot-sunxi-with-spl.bin" --ondisk mmcblk0 --no-table --align 8
part /boot/bootpart --source bootimg-partition --ondisk mmcblk0 --fstype=vfat --label boot --active --align 1024 --fixed-size 16
part /              --source rootfs --rootfs-dir=rootfs-main --ondisk mmcblk0 --fstype=ext4 --label rootfs1 --align 1024 --fixed-size 256 --exclude-path storage/
part                --source rootfs --rootfs-dir=rootfs-main --ondisk mmcblk0 --fstype=ext4 --label rootfs2 --align 1024 --fixed-size 256 --exclude-path storage/
part /storage       --source rootfs --rootfs-dir=rootfs-storage --ondisk mmcblk0 --fstype=ext4 --label storage --align 1024 --fixed-size 512
```

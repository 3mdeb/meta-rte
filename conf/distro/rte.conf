## conf/distro/rte.conf
```bitbake
DISTRO = "rte"
DISTRO_NAME = "RTE (Remote Test Environment Distro)"
DISTRO_VERSION = "0.7.5"
DISTRO_CODENAME = "dunfell"
SDK_VENDOR = "-rtesdk"
SDK_VERSION := "${@'${DISTRO_VERSION}'.replace('snapshot-${DATE}','snapshot')}"

MAINTAINER = "3mdeb <maciej.pijanowski@3mdeb.com>"

TARGET_VENDOR = "-rte"

LOCALCONF_VERSION = "1"

DISTRO_VERSION[vardepsexclude] = "DATE"
SDK_VERSION[vardepsexclude] = "DATE"

# Override these in poky based distros
RTE_DEFAULT_DISTRO_FEATURES = "largefile systemd"
RTE_DEFAULT_EXTRA_RDEPENDS = "packagegroup-core-boot"
RTE_DEFAULT_EXTRA_RRECOMMENDS = "kernel-module-af-packet"
MACHINE_ESSENTIAL_EXTRA_RRECOMMENDS += "kernel-modules kernel-devicetree"

DISTRO_FEATURES ?= "${DISTRO_FEATURES_DEFAULT} ${RTE_DEFAULT_DISTRO_FEATURES}"

# explicitely use systemd and disable sysvinit completely
VIRTUAL-RUNTIME_init_manager = "systemd"
VIRTUAL-RUNTIME_initscripts = ""
VIRTUAL-RUNTIME_syslog = ""
DISTRO_FEATURES_BACKFILL_CONSIDERED += "sysvinit pulseaudio"

####################################
### orange-pi-zero custom config ###
####################################
IMAGE_FSTYPES_orange-pi-zero = "wic.gz wic.bmap"
WIC_CREATE_EXTRA_ARGS = "--no-fstab-update"
KERNEL_IMAGETYPE_orange-pi-zero = "zImage"
IMAGE_BOOT_FILES_orange-pi-zero = " ${KERNEL_IMAGETYPE} ${KERNEL_DEVICETREE} boot.scr"
WKS_FILES = "sunxi-mmc-spl.wks"
WKS_FILE_DEPENDS_append = " u-boot"

SDK_NAME = "${DISTRO}-${TCLIBC}-${SDK_ARCH}-${IMAGE_BASENAME}-${TUNE_PKGARCH}"
SDKPATH = "/opt/${DISTRO}/${SDK_VERSION}"

DISTRO_EXTRA_RDEPENDS += " ${RTE_DEFAULT_EXTRA_RDEPENDS}"
DISTRO_EXTRA_RRECOMMENDS += " ${RTE_DEFAULT_EXTRA_RRECOMMENDS}"

POKYQEMUDEPS = "${@bb.utils.contains("INCOMPATIBLE_LICENSE", "GPL-3.0", "", "packagegroup-core-device-devel",d)}"
DISTRO_EXTRA_RDEPENDS_append_qemuarm = " ${POKYQEMUDEPS}"

# Add some rootfs extra space to store apu binaries for example (100MB)
IMAGE_ROOTFS_EXTRA_SPACE = "102400"

TCLIBCAPPEND = ""

WIC_CREATE_EXTRA_ARGS = "\
    --rootfs-dir rootfs-main=${IMAGE_ROOTFS} \
    --rootfs-dir rootfs-data=${IMAGE_ROOTFS}/data \
    "

QEMU_TARGETS ?= "arm"

PREMIRRORS ??= "\
bzr://.*/.*   http://downloads.yoctoproject.org/mirror/sources/ \n \
cvs://.*/.*   http://downloads.yoctoproject.org/mirror/sources/ \n \
git://.*/.*   http://downloads.yoctoproject.org/mirror/sources/ \n \
gitsm://.*/.* http://downloads.yoctoproject.org/mirror/sources/ \n \
hg://.*/.*    http://downloads.yoctoproject.org/mirror/sources/ \n \
osc://.*/.*   http://downloads.yoctoproject.org/mirror/sources/ \n \
p4://.*/.*    http://downloads.yoctoproject.org/mirror/sources/ \n \
svn://.*/.*   http://downloads.yoctoproject.org/mirror/sources/ \n"

MIRRORS =+ "\
ftp://.*/.*      http://downloads.yoctoproject.org/mirror/sources/ \n \
http://.*/.*     http://downloads.yoctoproject.org/mirror/sources/ \n \
https://.*/.*    http://downloads.yoctoproject.org/mirror/sources/ \n"

# The CONNECTIVITY_CHECK_URI's are used to test whether we can succesfully
# fetch from the network (and warn you if not). To disable the test set
# the variable to be empty.
# Git example url: git://git.yoctoproject.org/yocto-firewall-test;protocol=git;rev=master
CONNECTIVITY_CHECK_URIS ?= "https://www.example.com/"

SANITY_TESTED_DISTROS ?= " \
            ubuntu-16.04 \n \
            ubuntu-16.10 \n \
            debian-8 \n \
            debian-9 \n \
            "
#
# OELAYOUT_ABI allows us to notify users when the format of TMPDIR changes in
# an incompatible way. Such changes should usually be detailed in the commit
# that breaks the format and have been previously discussed on the mailing list
# with general agreement from the core team.
#
OELAYOUT_ABI = "12"

# add poky sanity bbclass
INHERIT += "poky-sanity"

# QA check settings - a little stricter than the OE-Core defaults
WARN_TO_ERROR_QA = "already-stripped compile-host-path install-host-path \
                    installed-vs-shipped ldflags pn-overrides rpaths staticdev \
                    useless-rpaths"
WARN_QA_remove = "${WARN_TO_ERROR_QA}"
ERROR_QA_append = " ${WARN_TO_ERROR_QA}"

require conf/distro/include/poky-world-exclude.inc
require conf/distro/include/no-static-libs.inc
require conf/distro/include/yocto-uninative.inc
INHERIT += "uninative"

# U-boot
PREFERRED_VERSION_u-boot = "2020.04"
```

## conf/layer.conf
```bitbake
# We have a conf and classes directory, add to BBPATH
BBPATH .= ":${LAYERDIR}"

# We have recipes-* directories, add to BBFILES
BBFILES += "${LAYERDIR}/recipes-*/*/*.bb ${LAYERDIR}/recipes-*/*/*.bbappend"

BBFILE_COLLECTIONS += "rte"
BBFILE_PATTERN_rte = "^${LAYERDIR}/"
BBFILE_PRIORITY_rte = "90"

# This should only be incremented on significant changes that will
# cause compatibility issues with other layers
LAYERVERSION_rte = "1"

LAYERDEPENDS_rte = "core"

LAYERSERIES_COMPAT_rte = "dunfell master"
```
